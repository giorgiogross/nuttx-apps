## examples/bmi055_example/Kconfig
```kconfig
config EXAMPLES_BMI055_EXAMPLE
	bool "Bmi055 accel and gyro sensor example"
	default n

if EXAMPLES_BMI055_EXAMPLE
endif # EXAMPLES_BMI055_EXAMPLE
```

## examples/vcnl4040_proximity/Kconfig
```kconfig
#
# For a description of the syntax of this configuration file,
# see the file kconfig-language.txt in the NuttX tools repository.
#

config EXAMPLES_VCNL4040_PROXIMITY
	bool "VCNL4040 proximity example"
	default n

if EXAMPLES_VCNL4040_PROXIMITY
endif # EXAMPLES_VCNL4040_PROXIMITY
```
